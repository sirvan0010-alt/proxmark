## firmware/ESP8684_Firmware/sdkconfig.defaults
```kconfig
CONFIG_IDF_TARGET="esp32c2"
CONFIG_ESPTOOLPY_FLASHSIZE_4MB=y
CONFIG_ESP_WIFI_SOFTAP_SUPPORT=y
CONFIG_ESP_WIFI_STA_SUPPORT=y
CONFIG_ESP_WIFI_APSTA_SUPPORT=y
CONFIG_ESP_WIFI_PROMISCUOUS_SUPPORT=y
CONFIG_ESP_MAIN_TASK_STACK_SIZE=8192
```
